#include <ArduinoJson.h>
#include <HTTPClient.h>
#include <WiFi.h>

// --- Configuration ---
const char *ssid = "YOUR_WIFI_SSID";
const char *password = "YOUR_WIFI_PASSWORD";
String serverUrl = "http://192.168.2.110:8000/api/v1";

// Device Identity
// NOTE: Use the UUID generated by Server or one you want to enforce.
// Test Server creates one if missing.
String device_id = "";
const char *mac_address = "AA:BB:CC:DD:EE:FF";
const char *device_name = "RemoteTest ESP32-C3";

// GPIOs to Control
const int LED_PIN = 2; // Example for onboard LED or external

// State
int lastCommandId = 0;

void setup() {
  Serial.begin(115200);
  pinMode(LED_PIN, OUTPUT);
  digitalWrite(LED_PIN, LOW); // Off initially

  delay(1000);
  Serial.println("\n--- ESP32-C3 Remote Test ---");

  connectToWiFi();
  registerDevice();
}

void loop() {
  if (WiFi.status() == WL_CONNECTED && device_id != "") {
    pollForCommands();
  }
  delay(2000); // Poll every 2 seconds
}

void connectToWiFi() {
  Serial.print("Connecting to WiFi: ");
  Serial.println(ssid);
  WiFi.mode(WIFI_STA);
  WiFi.begin(ssid, password);

  int attempts = 0;
  while (WiFi.status() != WL_CONNECTED && attempts < 20) {
    delay(500);
    Serial.print(".");
    attempts++;
  }
  if (WiFi.status() == WL_CONNECTED) {
    Serial.println("\nWiFi connected!");
    Serial.println(WiFi.localIP());
  } else {
    Serial.println("\nFailed to connect to WiFi.");
  }
}

void registerDevice() {
  if (WiFi.status() != WL_CONNECTED)
    return;
  HTTPClient http;
  String url = serverUrl + "/config";

  StaticJsonDocument<512> doc;
  // Send empty device_id to get a new one assigned, OR use existing if you have
  // one. We send empty string if we don't have one yet.
  if (device_id != "") {
    doc["device_id"] = device_id;
  }
  doc["mac_address"] = mac_address;
  doc["name"] = device_name;
  doc["mode"] = "library";
  doc["firmware_version"] = "1.0.0";

  JsonArray pins = doc.createNestedArray("pins");
  JsonObject pin1 = pins.createNestedObject();
  pin1["gpio_pin"] = LED_PIN;
  pin1["mode"] = "OUTPUT";
  pin1["function"] = "Light";
  pin1["label"] = "Test LED";

  String requestBody;
  serializeJson(doc, requestBody);

  http.begin(url);
  http.addHeader("Content-Type", "application/json");
  int httpCode = http.POST(requestBody);

  if (httpCode == 200) {
    String response = http.getString();
    StaticJsonDocument<512> respDoc;
    deserializeJson(respDoc, response);
    const char *id = respDoc["device_id"];
    device_id = String(id);
    Serial.println("Registered! Assigned UUID: " + device_id);
  } else {
    Serial.println("Registration Failed: " + String(httpCode));
    Serial.println(http.getString());
  }
  http.end();
}

void pollForCommands() {
  HTTPClient http;
  String url = serverUrl + "/device/" + device_id + "/command/latest";

  http.begin(url);
  int httpCode = http.GET();

  if (httpCode == 200) {
    String payload = http.getString();
    StaticJsonDocument<1024> doc;
    deserializeJson(doc, payload);

    String status = doc["status"];
    if (status == "ok") {
      int cmdId = doc["command_id"];
      if (cmdId > lastCommandId) {
        lastCommandId = cmdId;
        String cmdPayload = doc["payload"]; // e.g., "{'action': 'on'}"

        Serial.println("New Command Received: " + cmdPayload);

        // Allow sloppy JSON parsing since payload might be stringified dict
        // from Python ideally we parse it properly.
        if (cmdPayload.indexOf("'action': 'on'") >= 0 ||
            cmdPayload.indexOf("\"action\": \"on\"") >= 0) {
          digitalWrite(LED_PIN, HIGH);
          Serial.println("LED ON");
        } else if (cmdPayload.indexOf("'action': 'off'") >= 0 ||
                   cmdPayload.indexOf("\"action\": \"off\"") >= 0) {
          digitalWrite(LED_PIN, LOW);
          Serial.println("LED OFF");
        }
      }
    }
  }
  http.end();
}
